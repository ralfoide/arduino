#define USB_CFG_DEVICE_NAME     'D','i','g','i','B','l','i','n','k'
#define USB_CFG_DEVICE_NAME_LEN 9
#include <DigiUSB.h>
byte in = 0;
int Blue = 0;
int Red = 0;
int Green = 0;

int next = 0;

void setup() {
    DigiUSB.begin();
    pinMode(0,OUTPUT);
    pinMode(1,OUTPUT);
    pinMode(2,OUTPUT);
    
    // Quick init
    Red = 64; updateLed();
    delay(250);
    Red = 0; Green = 64; updateLed();
    delay(250);
    Green = 0; Blue = 64; updateLed();
    delay(250);
    Blue = 0; updateLed();
}

// convert 0..9 into 0..255 range using exponential curve
// because the led brightness isn't linear.
// generated by 
// C3=256/exp(9*C4)
// C4=0.6
// X=0-9 ==> Y=int(C3 * exp(X * C4)) - 1
int table[10] = { 0, 1, 3, 6, 12, 22, 41, 76, 139, 255 };

int lookup(int c) {
  c = c - '0';
  if (c < 0) c = 0;
  if (c > 9) c = 9;
  return table[c];
}

void loop() {
  setBlue();
      DigiUSB.refresh();
      setBlue();
     if (DigiUSB.available() > 0) {
       in = 0;
       
       in = DigiUSB.read();
       if (next == 0){
         if(in == 115){  // "s"
           next = 1;
           DigiUSB.println("Start");
         }
       }
       else if (next == 1){
            Red = lookup(in);
            DigiUSB.print("Red ");
            DigiUSB.println(Red,DEC);
            next = 2;
       }
       else if (next == 2){
            Green = lookup(in);
            DigiUSB.print("Green ");
            DigiUSB.println(Green,DEC);
            next = 3;
       }
       else if (next == 3){
            Blue = lookup(in);
            DigiUSB.print("Blue ");
            DigiUSB.println(Blue,DEC);
            next = 0;
       }
     }
     
     updateLed();
}

void updateLed() {
    analogWrite(0,Red);
    analogWrite(1,Green);
    setBlue();
}

void setBlue(){
    if(Blue == 0){
      digitalWrite(2,LOW);
      return;
    }
    else if(Blue == 255){
      digitalWrite(2,HIGH);
      return;
    }
    // On period  
    for (int x=0;x<Blue;x++){
    digitalWrite(2,HIGH);
    } 
    
    // Off period
    
    for(int x=0;x<(255-Blue);x++){
    digitalWrite(2,LOW);
    }
  
} 

